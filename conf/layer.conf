## conf/layer.conf
```bitbake
# We have a conf and classes directory, add to BBPATH
BBPATH .= ":${LAYERDIR}"

# We have recipes-* directories, add to BBFILES
BBFILES += "${LAYERDIR}/recipes-*/*/*.bb ${LAYERDIR}/recipes-*/*/*.bbappend"

BBFILE_COLLECTIONS += "nmrouter"
BBFILE_PATTERN_nmrouter = "^${LAYERDIR}/"
BBFILE_PRIORITY_nmrouter = "10"

# This should only be incremented on significant changes that will
# cause compatibility issues with other layers
LAYERVERSION_nmrouter = "1"

LAYERDEPENDS_nmrouter = "core"
```

## conf/machine/am335x-nbhw16-fct.conf
```bitbake
#@TYPE: Machine
#@NAME: BeagleBone machine
#@DESCRIPTION: Machine configuration for the http://beagleboard.org/bone board 

require conf/machine/am335x-nbhw16.conf
```

## conf/machine/am335x-nbhw16.conf
```bitbake
#@TYPE: Machine
#@NAME: NBHW16 based routers like NB800
#@DESCRIPTION: Machine configuration for the NBHW16 based routers http://netmodule.com/en/products/iot-routers

require conf/machine/include/ti33x.inc

IMAGE_FSTYPES += "tar.gz cpio cpio.gz.u-boot"
IMAGE_CLASSES += "image_types_uboot"

MACHINE_EXTRA_RRECOMMENDS = " kernel-modules kernel-devicetree"

KERNEL_DEFCONFIG = "nbhw16_defconfig"
KERNEL_DEVICETREE = "am335x-nbhw16.dtb \
    am335x-nbhw16-prod2.dtb \
    am335x-nbhw16-prod3.dtb \
    am335x-nbhw16-prod4.dtb \
    am335x-nbhw16-prod5.dtb \
    "
KERNEL_IMAGETYPE = "zImage"

PREFERRED_PROVIDER_virtual/kernel = "linux-netmodule"
PV_pn-linux-netmodule = "4.4.71-${SRCPV}"
SRC_URI_pn-linux-netmodule = "git://github.com/netmodule/linux.git;protocol=https;branch=nbhw16-4.4-pm-ti"
SRCREV_pn-linux-netmodule = "ad39a4ea4151b886a6d56fe5b7b01a86d9603c4d"
```

## conf/machine/armada-370.conf
```bitbake
#@TYPE: Machine
#@NAME: AM437x EVM
#@DESCRIPTION: Machine configuration for the TI AM437x EVM

require conf/machine/include/armada.inc

DEFAULTTUNE = "armv7a"

IMAGE_FSTYPES += "tar.gz"

SERIAL_CONSOLE = "115200 ttyS0"
```

## conf/machine/armada-385-nbhw14.conf
```bitbake
#@TYPE: Machine
#@NAME: NBHW14 based routers like NB3800
#@DESCRIPTION: Machine configuration for the Armada based http://netmodule.com/en/products/railway-routers/NB3800

require conf/machine/include/armada.inc

IMAGE_FSTYPES += "tar.gz cpio cpio.gz.u-boot"
IMAGE_CLASSES += "image_types_uboot"

SERIAL_CONSOLE = "115200 ttyS1"
MACHINE_EXTRA_RRECOMMENDS = " kernel-modules kernel-devicetree"

KERNEL_DEFCONFIG = "nbhw_defconfig"
KERNEL_DEVICETREE = "armada-385-nbhw14-prod1.dtb \
					 armada-385-nbhw14-prod2.dtb \
					"
KERNEL_IMAGETYPE = "zImage"

PREFERRED_PROVIDER_virtual/kernel = "linux-netmodule"
PV_pn-linux-netmodule = "4.12.0-${SRCPV}"
SRC_URI_pn-linux-netmodule = "git://github.com/netmodule/linux.git;protocol=https;branch=nbhw14-4.12"
SRCREV_pn-linux-netmodule = "2fb3360ec3cf672c74321e1dbe5c04e59d1ced11"
```

## conf/machine/armada-385-nbhw17-nb2800.conf
```bitbake
#@TYPE: Machine
#@NAME: NB2800
#@DESCRIPTION: Machine configuration for the Armada based NB2800

require conf/machine/include/armada.inc

# Prepend amrada-395 to machines
MACHINEOVERRIDES =. "armada-385:"

IMAGE_FSTYPES += "tar.gz cpio cpio.gz.u-boot"
IMAGE_CLASSES += "image_types_uboot"

MACHINE_EXTRA_RRECOMMENDS = " kernel-modules kernel-devicetree"

KERNEL_DEFCONFIG = "nbhw_defconfig"
KERNEL_DEVICETREE = "armada-385-nbhw17-nb2800.dtb"
KERNEL_IMAGETYPE = "zImage"

PREFERRED_PROVIDER_virtual/kernel ?= "linux-netmodule"
PREFERRED_VERSION_linux ?= "4.7%"
BRANCH_pn-linux-netmodule = "nbhw17-4.7"

SERIAL_CONSOLE = "115200 ttyS0"
```

## conf/machine/armada-385-nbhw17.conf
```bitbake
#@TYPE: Machine
#@NAME: NBHW17 based routers like NB2800
#@DESCRIPTION: Machine configuration for the NBHW17 based routers http://netmodule.com/en/products/vehicle-routers/NB2800

require conf/machine/include/armada.inc

IMAGE_FSTYPES += "tar.gz cpio cpio.gz.u-boot"
IMAGE_CLASSES += "image_types_uboot"

SERIAL_CONSOLE = "115200 ttyS1"
MACHINE_EXTRA_RRECOMMENDS = " kernel-modules kernel-devicetree"

KERNEL_DEFCONFIG = "nbhw_defconfig"
KERNEL_DEVICETREE = "armada-385-nbhw17-prod1.dtb"
KERNEL_IMAGETYPE = "zImage"

PREFERRED_PROVIDER_virtual/kernel = "linux-netmodule"
PV_pn-linux-netmodule = "4.12.0-${SRCPV}"
SRC_URI_pn-linux-netmodule = "git://github.com/netmodule/linux.git;protocol=https;branch=nbhw14-4.12"
SRCREV_pn-linux-netmodule = "2fb3360ec3cf672c74321e1dbe5c04e59d1ced11"
```

## conf/machine/armada-385.conf
```bitbake
#@TYPE: Machine
#@NAME: AM437x EVM
#@DESCRIPTION: Machine configuration for the TI AM437x EVM

require conf/machine/include/armada.inc

IMAGE_FSTYPES += "tar.gz cpio cpio.gz.u-boot"
IMAGE_CLASSES += "image_types_uboot"

SERIAL_CONSOLE = "115200 ttyS0"
```

## conf/machine/beaglebone.conf
```bitbake
#@TYPE: Machine
#@NAME: BeagleBone machine
#@DESCRIPTION: Machine configuration for the http://beagleboard.org/bone board 

require conf/machine/include/ti33x.inc

IMAGE_FSTYPES += "tar.gz cpio cpio.gz.u-boot"
IMAGE_CLASSES += "image_types_uboot"

MACHINE_EXTRA_RRECOMMENDS = " kernel-modules kernel-devicetree"

KERNEL_DEFCONFIG = "nbhw16_defconfig"
KERNEL_DEVICETREE = "am335x-boneblack.dtb"
KERNEL_IMAGETYPE = "zImage"

UBOOT_MACHINE = "am335x_boneblack_config"

PREFERRED_PROVIDER_virtual/kernel = "linux-netmodule"
BRANCH_pn-linux-netmodule = "nbhw16-4.4"
PREFERRED_VERSION_linux = "4.4%"

SERIAL_CONSOLE = "115200 ttyO0"
```

## conf/machine/include/armada.inc
```bitbake
SOC_FAMILY = "armada"
require conf/machine/include/soc-family.inc

DEFAULTTUNE ?= "cortexa9thf-neon"
require conf/machine/include/tune-cortexa9.inc

# Default providers, may need to override for specific machines
PREFERRED_PROVIDER_virtual/bootloader = "u-boot"
PREFERRED_PROVIDER_u-boot = "u-boot"

KERNEL_IMAGETYPE = "zImage"

UBOOT_ARCH = "arm"
UBOOT_MACHINE = "mvebu"

UBOOT_ENTRYPOINT = "0x80008000"
UBOOT_LOADADDRESS = "0x80008000"

# List common SoC features, may need to add touchscreen for specific machines
MACHINE_FEATURES = "kernel26 usbgadget usbhost vfat ext2 ext4 ethernet"
```
